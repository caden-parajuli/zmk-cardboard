#include "cardboard.dtsi"

&default_transform {
    col-offset = <5>;
};

&kscan0 {
    row-gpios
        = <&gpio0 17 (GPIO_ACTIVE_HIGH)> // Row A from the schematic file
        , <&gpio0 22 (GPIO_ACTIVE_HIGH)> // Row B from the schematic file
        , <&gpio1 0  (GPIO_ACTIVE_HIGH)> // Row C from the schematic file
        , <&xiao1 6  (GPIO_ACTIVE_HIGH)> // Row D from the schematic file
        ;
    col-gpios
        = <&gpio0 20 (GPIO_ACTIVE_HIGH | GPIO_PULL_DOWN)> // col1 in the schematic
        , <&gpio0 24 (GPIO_ACTIVE_HIGH | GPIO_PULL_DOWN)> // col2 in the schematic
        , <&gpio0 11 (GPIO_ACTIVE_HIGH | GPIO_PULL_DOWN)> // col3 in the schematic
        , <&gpio1 04 (GPIO_ACTIVE_HIGH | GPIO_PULL_DOWN)> // col4 in the schematic
        , <&gpio0 9  (GPIO_ACTIVE_HIGH | GPIO_PULL_DOWN)> // col5 in the schematic
        ;
};
