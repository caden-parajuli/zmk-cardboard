## boards/shields/cardboard/Kconfig.defconfig
```kconfig
if SHIELD_CARDBOARD_LEFT

config ZMK_KEYBOARD_NAME
    default "Cardboard"

config ZMK_SPLIT_ROLE_CENTRAL
    default y

endif

if SHIELD_CARDBOARD_LEFT || SHIELD_CARDBOARD_RIGHT

config ZMK_SPLIT
    default y

endif
```

## boards/shields/cardboard/Kconfig.shield
```kconfig
config SHIELD_CARDBOARD_LEFT
    def_bool $(shields_list_contains,cardboard_left)

config SHIELD_CARDBOARD_RIGHT
    def_bool $(shields_list_contains,cardboard_right)
```

## config/west.yml
```yaml
manifest:
  remotes:
    - name: zmkfirmware
      url-base: https://github.com/zmkfirmware
    - name: cardboard
      url-base: https://github.com/caden-parajuli
  projects:
    - name: zmk
      remote: zmkfirmware
      revision: main
      import: app/west.yml
  self:
    path: config
```
